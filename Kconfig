## Kconfig
```kconfig
# SPDX-License-Identifier: MIT

mainmenu "Davix ($(ARCH)) configuration"

menu "Compiler options"

config CHECKER
	bool "Run \"sparse\" on all C files."
	default n
	help
		"sparse" is a Linux kernel development utility that employs
		static analysis on C code to diagnose errors. It can however be
		used by other projects too.

		If you are a kernel developer, say "y".

		Otherwise, say "n".

config CROSS_COMPILE
	string "Cross-prefix"
	default "$(CROSS_COMPILE_DEFAULT)"
	help
		A string prefixed to all GCC and Binutils executables.

endmenu

source "arch/$(ARCH)/Kconfig"

source "kernel/Kconfig"

source "mm/Kconfig"

source "acpi/Kconfig"
```

## arch/x86/Kconfig
```kconfig
# SPDX-License-Identifier: MIT

config X86
	def_bool y
	select HAVE_PGCACHEMODE_WRITETHROUGH
	select HAVE_PGCACHEMODE_WRITECOMBINING
	select HAVE_PGCACHEMODE_UNCACHED_MINUS

menu "Architecture-specific options"

config MULTIBOOT2_LOADER
	bool "Build the included multiboot2 loader."
	default y

source "arch/x86/loader/Kconfig"

endmenu
```

## arch/x86/loader/Kconfig
```kconfig
# SPDX-License-Identifier: MIT

choice
	prompt "Loader loglevel"
	default LOADER_LOGLEVEL_WARN

config LOADER_LOGLEVEL_DEBUG
	bool "Debug"
	help
		Enable all printk() statements in the loader.

config LOADER_LOGLEVEL_INFO
	bool "Info"
	help
		Enable printk() statements with a loglevel of INFO and above in
		the loader.

config LOADER_LOGLEVEL_WARN
	bool "Warning"
	help
		Enable printk() statements with a loglevel of WARN and above in
		the loader.

config LOADER_LOGLEVEL_ERROR
	bool "Error"
	help
		Enable printk() statements with a loglevel of ERROR and above in
		the loader.

endchoice
```

## kernel/Kconfig
```kconfig
# SPDX-License-Identifier: MIT

menu "General kernel options"

config EXTRAVERSION
	string "Extra version"
	default ""
	help
		A string appended to the kernel version string.

config DEBUG_BUILD
	bool "Debug build"
	default n
	help
		Enable additional code and compiler flags, such as
		-fno-omit-frame-pointer and -fno-optimize-sibling-calls, for
		debugging purposes.

endmenu
```

## mm/Kconfig
```kconfig
# SPDX-License-Identifier: MIT

config HAVE_PGCACHEMODE_WRITETHROUGH
	bool

config HAVE_PGCACHEMODE_WRITECOMBINING
	bool

config HAVE_PGCACHEMODE_UNCACHED_MINUS
	bool
```
